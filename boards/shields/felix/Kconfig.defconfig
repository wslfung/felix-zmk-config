## boards/shields/felix/Kconfig.defconfig
```kconfig
# Copyright (c) 2020 The ZMK Contributors
# SPDX-License-Identifier: MIT

if SHIELD_FELIX_LEFT

config ZMK_KEYBOARD_NAME
    default "Felix"

config ZMK_SPLIT_ROLE_CENTRAL
    default y

endif

if SHIELD_FELIX_LEFT || SHIELD_FELIX_RIGHT

config ZMK_SPLIT
    default y

endif
```
